## conf/machine/ultra96.conf
```bitbake
#@TYPE: Machine
#@NAME: ultra96-zynqmp
#@DESCRIPTION: Machine support for Ultra96 Evaluation Board.
#

SOC_VARIANT ?= "eg"

require conf/machine/include/soc-zynqmp.inc
require conf/machine/include/machine-xilinx-default.inc

#MACHINE_FEATURES = "rtc ext2 ext3 vfat usbhost usbgadget wifi bluetooth mipi"
MACHINE_FEATURES = "rtc ext2 ext3 vfat usbhost"

#SPL_BINARY ?= "spl/boot.bin"
UBOOT_MACHINE ?= "xilinx_zynqmp_ultra96_v2_defconfig"
KERNEL_DEVICETREE ?= "xilinx/zynqmp-zcu100-revC.dtb"
PREFERRED_PROVIDER_virtual/kernel ?= "linux-yocto"
KERNEL_CC_append += " -D__NONE_PETALINUX__"

SERIAL_CONSOLES ?= "115200;ttyPS0"

PMU_FIRMWARE_IMAGE_NAME ?= "pmu-firmware-zynqmp-pmu"
PMU_FIRMWARE_DEPLOY_DIR ?= "${TOPDIR}/pmutmp/deploy/images/zynqmp-pmu"

EXTRA_IMAGEDEPENDS += " \
		arm-trusted-firmware \
		virtual/bootloader \
		u-boot-zynq-scr \
		"
IMAGE_BOOT_FILES += " \
               boot.scr \
               "
#MACHINE_ESSENTIAL_EXTRA_RRECOMMENDS += "linux-firmware-wl18xx"
```

## conf/machine/ultra96v2.conf
```bitbake
#@TYPE: Machine
#@NAME: ultra96-zynqmp
#@DESCRIPTION: Machine support for Ultra96 Evaluation Board.
#

SOC_VARIANT ?= "eg"

require conf/machine/include/soc-zynqmp.inc
require conf/machine/include/machine-xilinx-default.inc

#MACHINE_FEATURES = "rtc ext2 ext3 vfat usbhost usbgadget wifi bluetooth mipi"
MACHINE_FEATURES = "rtc ext2 ext3 vfat usbhost"

#SPL_BINARY ?= "spl/boot.bin"
UBOOT_MACHINE ?= "xilinx_zynqmp_ultra96_v2_defconfig"
UBOOT_DEFCONFIG = "xilinx_zynqmp_ultra96_v2_defconfig"
UBOOT_DEVICETREE = "zynqmp-ultra96-v2"
KERNEL_DEVICETREE ?= "xilinx/zynqmp-ultra96-v2.dtb"
PREFERRED_PROVIDER_virtual/kernel ?= "linux-yocto"
KERNEL_CC_append += " -D__NONE_PETALINUX__"

SERIAL_CONSOLES ?= "115200;ttyPS0"

PMU_FIRMWARE_IMAGE_NAME ?= "pmu-firmware-microblaze-pmu"
PMU_FIRMWARE_DEPLOY_DIR ?= "${TOPDIR}/pmutmp/deploy/images/microblaze-pmu"

EXTRA_IMAGEDEPENDS += " \
		arm-trusted-firmware \
		virtual/bootloader \
		u-boot-zynq-scr \
		"
IMAGE_BOOT_FILES += " \
               boot.scr \
               "
#MACHINE_ESSENTIAL_EXTRA_RRECOMMENDS += "linux-firmware-wl18xx"
```
